## Kconfig
```kconfig
# SPDX-License-Identifier: GPL-2.0-or-later

config QBC_URLF
	tristate "Qubercomm URLF module"
	default y
	help
		Qubercomm URL Filter module
```

## kspace/Kconfig
```kconfig
config QBC_URLF
	tristate "Qubercomm URLF module"
	default y
	help
		Qubercomm URL Filter module
```
